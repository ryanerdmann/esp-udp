## main/Kconfig.projbuild
```kconfig
menu "Application Wi-Fi"

    config APP_WIFI_SSID
        string "Wi-Fi network name (SSID)"
        default ""
        help
            Local network name. Stored in the ignored sdkconfig and firmware.

    config APP_WIFI_PASSWORD
        string "Wi-Fi password"
        default ""
        help
            Local network password. Leave empty only for an open network.
            Stored in plaintext in the ignored sdkconfig and firmware.

endmenu
```

## sdkconfig.defaults
```kconfig
CONFIG_IDF_TARGET="esp32s3"
CONFIG_BLINK_LED_STRIP=y
CONFIG_BLINK_LED_STRIP_BACKEND_RMT=y
CONFIG_BLINK_GPIO=48
CONFIG_BLINK_PERIOD=1000
CONFIG_ESPTOOLPY_FLASHSIZE_16MB=y
```
